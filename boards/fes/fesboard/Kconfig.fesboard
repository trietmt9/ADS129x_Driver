## boards/fes/fesboard/Kconfig.fesboard
```kconfig
# FES Board board definition
# SPDX-License-Identifier: Apache-2.0

config BOARD_FESBOARD
	select SOC_STM32F767XX
```

## boards/fes/fesboard/board.yml
```yaml
board:
  name: fesboard
  full_name: FES Board (STM32F767ZI biopotential AFE)
  vendor: fes
  socs:
    - name: stm32f767xx
```
